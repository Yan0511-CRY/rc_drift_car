/**
 * oled.c — SSD1306 0.96寸 OLED 驱动实现
 *
 * 帧缓冲 + 全屏DMA/IT刷新, 中文标注关键寄存器
 */

#include "oled.h"

/* ==================== 6×8 ASCII 字库 (0x20–0x7F) ==================== */
static const uint8_t Font6x8[][6] = {
    {0x00,0x00,0x00,0x00,0x00,0x00}, /*   */
    {0x00,0x00,0x5F,0x00,0x00,0x00}, /* ! */
    {0x00,0x07,0x00,0x07,0x00,0x00}, /* " */
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    {0x08,0x04,0x08,0x10,0x08,0x00}, /* ~ */
};

/* ==================== 模块级变量 ==================== */
static I2C_HandleTypeDef *oled_i2c;

/* 帧缓冲: OLED_WIDTH × OLED_PAGES (128×8=1024字节) */
static uint8_t framebuffer[OLED_WIDTH * OLED_PAGES];

/* 当前光标位置 (字符坐标) */
static uint8_t cursor_col;
static uint8_t cursor_row;

/* ==================== 底层 I2C 通信 ==================== */

/**
 * @brief 发送单字节命令到SSD1306
 * @param cmd 命令字节
 * @note  I2C序列: [控制字节0x00=命令模式][命令字节]
 */
static void OLED_WriteCmd(uint8_t cmd) {
    uint8_t buf[2] = {0x00, cmd};
    HAL_I2C_Master_Transmit(oled_i2c, OLED_I2C_ADDR << 1, buf, 2, 10);
}

/**
 * @brief 发送多字节命令序列到SSD1306
 * @param cmds 命令字节数组
 * @param len  数组长度
 */
static void OLED_WriteCmd_Multi(const uint8_t *cmds, uint8_t len) {
    /* 需要额外1字节放控制字节0x00 */
    uint8_t buf[32];
    if (len > sizeof(buf) - 1) return;
    buf[0] = 0x00;
    for (uint8_t i = 0; i < len; i++) {
        buf[i + 1] = cmds[i];
    }
    HAL_I2C_Master_Transmit(oled_i2c, OLED_I2C_ADDR << 1, buf, len + 1, 20);
}

/**
 * @brief 发送帧缓冲数据到GDDRAM (全屏刷新)
 * @note  单页128字节 + 控制字节 = 129字节/次, 分8页发送
 *        控制字节0x40 = 数据模式 (Co=0, D/C#=1)
 */
static void OLED_WriteData(const uint8_t *data, uint16_t len) {
    /* 分页发送, 每页129字节 (1控制 + 128数据) */
    for (uint8_t page = 0; page < OLED_PAGES; page++) {
        uint8_t buf[129];
        buf[0] = 0x40; /* 数据模式 */
        for (uint8_t col = 0; col < OLED_WIDTH; col++) {
            buf[col + 1] = data[page * OLED_WIDTH + col];
        }
        HAL_I2C_Master_Transmit(oled_i2c, OLED_I2C_ADDR << 1, buf, 129, 50);
    }
}

/* ==================== SSD1306 初始化命令序列 ==================== */

void OLED_Init(I2C_HandleTypeDef *hi2c) {
    oled_i2c = hi2c;

    /* 上电后等待稳定 */
    HAL_Delay(100);

    /* ---- SSD1306 初始化序列 (按数据手册Page 64) ---- */
    OLED_WriteCmd(0xAE); /* ① 关闭显示 */

    OLED_WriteCmd(0x20); /* ② 设置内存寻址模式 */
    OLED_WriteCmd(0x00); /*    水平寻址模式 */

    OLED_WriteCmd(0xB0); /* ③ 设置页起始地址 Page0 */

    OLED_WriteCmd(0xC8); /* ④ COM输出扫描方向: 从COM63到COM0 */

    OLED_WriteCmd(0x00); /* ⑤ 列起始地址低4位 */
    OLED_WriteCmd(0x10); /*    列起始地址高4位 */

    OLED_WriteCmd(0x40); /* ⑥ 显示起始行=0 */

    OLED_WriteCmd(0x81); /* ⑦ 对比度 */
    OLED_WriteCmd(0x7F); /*    对比度值 0~255 (默认127) */

    OLED_WriteCmd(0xA1); /* ⑧ 段重映射: 列127映射到SEG0 */

    OLED_WriteCmd(0xA6); /* ⑨ 正常显示 (非反色) */

    OLED_WriteCmd(0xA8); /* ⑩ 多路复用比 */
    OLED_WriteCmd(0x3F); /*    64路 (0x3F = 63, 即64行) */

    OLED_WriteCmd(0xA4); /* ⑪ 全屏显示关闭 (按GDDRAM内容显示) */

    OLED_WriteCmd(0xD3); /* ⑫ 显示偏移 */
    OLED_WriteCmd(0x00); /*    偏移=0 */

    OLED_WriteCmd(0xD5); /* ⑬ 显示时钟分频/振荡器频率 */
    OLED_WriteCmd(0xF0); /*    分频=1, 频率≈1150fps */

    OLED_WriteCmd(0xD9); /* ⑭ 预充电周期 */
    OLED_WriteCmd(0x22); /*    Phase1=2 DCLK, Phase2=2 DCLK */

    OLED_WriteCmd(0xDA); /* ⑮ COM引脚硬件配置 */
    OLED_WriteCmd(0x12); /*    顺序/可选的COM引脚重映射 */

    OLED_WriteCmd(0xDB); /* ⑯ VCOMH去选电平 */
    OLED_WriteCmd(0x20); /*    ~0.77×VCC */

    OLED_WriteCmd(0x8D); /* ⑰ 电荷泵设置 */
    OLED_WriteCmd(0x14); /*    使能电荷泵 (3.3V供电必须) */

    OLED_WriteCmd(0xAF); /* ⑱ 开启显示 */

    OLED_Clear();
    OLED_Refresh();
}

/* ==================== 帧缓冲操作 ==================== */

void OLED_Clear(void) {
    memset(framebuffer, 0x00, sizeof(framebuffer));
    cursor_col = 0;
    cursor_row = 0;
}

void OLED_Fill(unsigned char data) {
    memset(framebuffer, data, sizeof(framebuffer));
}

/**
 * @brief 将帧缓冲全量写入SSD1306 GDDRAM
 */
void OLED_Refresh(void) {
    OLED_WriteData(framebuffer, sizeof(framebuffer));
}

void OLED_ClearAndRefresh(void) {
    OLED_Clear();
    OLED_Refresh();
}

/* ==================== 光标与字符绘制 ==================== */

/**
 * @brief 设置字符坐标光标
 * @param col 列 (0~20, 对应 0~126 像素)
 * @param row 行 (0~7,  对应 0~56 像素)
 */
void OLED_SetCursor(unsigned char col, unsigned char row) {
    if (col >= OLED_COLS) col = OLED_COLS - 1;
    if (row >= OLED_ROWS) row = OLED_ROWS - 1;
    cursor_col = col;
    cursor_row = row;
}

/**
 * @brief 在帧缓冲中绘制一个ASCII字符 (6×8 像素)
 * @note  自动换行, 超出屏幕末尾不显示
 */
static void OLED_DrawChar(char ch) {
    if (ch < 0x20 || ch > 0x7E) ch = ' '; /* 不可打印字符→空格 */

    unsigned char col = cursor_col;
    unsigned char row = cursor_row;

    /* 自动换行 */
    if (col >= OLED_COLS) {
        col = 0;
        row++;
        cursor_col = 0;
        cursor_row = row;
    }
    if (row >= OLED_ROWS) return; /* 超出屏幕范围 */

    uint8_t char_index = (uint8_t)(ch - 0x20);

    /* 将6列字模写入帧缓冲对应页 */
    for (uint8_t x = 0; x < 6; x++) {
        uint16_t fb_index = row * OLED_WIDTH + col * 6 + x;
        if (fb_index < sizeof(framebuffer)) {
            framebuffer[fb_index] = Font6x8[char_index][x];
        }
    }

    /* 列间加1像素空白间隔 (清零第7列) */
    if (col < OLED_COLS - 1) {
        uint16_t fb_index = row * OLED_WIDTH + col * 6 + 6;
        if (fb_index < sizeof(framebuffer)) {
            framebuffer[fb_index] = 0x00;
        }
    }

    cursor_col = col + 1;
}

/**
 * @brief 打印字符串到光标位置
 */
void OLED_Print(const char *str) {
    while (*str) {
        OLED_DrawChar(*str);
        str++;
    }
}

/**
 * @brief 打印有符号整数
 */
void OLED_PrintInt(int32_t val) {
    char buf[12];
    int i = 0;
    uint8_t negative = 0;

    if (val < 0) {
        negative = 1;
        val = -val;
    }

    /* 从个位开始填充 (逆序) */
    do {
        buf[i++] = '0' + (val % 10);
        val /= 10;
    } while (val > 0 && i < 10);

    if (negative) buf[i++] = '-';

    /* 反转输出 */
    for (int j = i - 1; j >= 0; j--) {
        char ch[2] = {buf[j], '\0'};
        OLED_Print(ch);
    }
}

/**
 * @brief 打印浮点数
 * @param val         数值
 * @param int_digits  整数部分最小宽度 (不足补空格)
 * @param frac_digits 小数位数 (0~4)
 */
void OLED_PrintFloat(float val, unsigned char int_digits, unsigned char frac_digits) {
    if (frac_digits > 4) frac_digits = 4;

    /* 处理负号 */
    if (val < 0) {
        OLED_DrawChar('-');
        val = -val;
        if (int_digits > 0) int_digits--;
    }

    /* 整数部分 */
    int32_t int_part = (int32_t)val;
    float frac_part = val - int_part;

    /* 计算整数宽度用于补空格 */
    int32_t tmp = int_part;
    uint8_t int_width = (tmp == 0) ? 1 : 0;
    while (tmp > 0) { int_width++; tmp /= 10; }

    /* 前导空格补位 */
    while (int_digits > int_width) {
        OLED_DrawChar(' ');
        int_digits--;
    }

    /* 输出整数 */
    OLED_PrintInt(int_part);

    /* 小数部分 */
    if (frac_digits > 0) {
        OLED_DrawChar('.');
        for (uint8_t i = 0; i < frac_digits; i++) {
            frac_part *= 10;
            uint8_t digit = (uint8_t)frac_part;
            frac_part -= digit;
            char ch[2] = {'0' + digit, '\0'};
            OLED_Print(ch);
        }
    }
}
